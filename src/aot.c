#include "aot.h"
#include "rom_stubs.h"  /* HOOK_BITMAP_BITS / HOOK_BITMAP_WORDS */


#include <dlfcn.h>
#include <errno.h>
#include <stdio.h>
#include <stdlib.h>
#include <string.h>

#if defined(__APPLE__)
#  include <mach-o/dyld.h>
#  include <mach-o/loader.h>
#  include <mach-o/nlist.h>
#endif
#if defined(__linux__)
#  include <link.h>
#endif

/* Hash map keyed by guest PC. Open addressing, power-of-two size,
 * tombstone-free (dylib is loaded once at startup, never mutated). */
#define AOT_HASH_BITS  14
#define AOT_HASH_SIZE  (1u << AOT_HASH_BITS)
#define AOT_HASH_MASK  (AOT_HASH_SIZE - 1)

typedef struct {
    uint32_t   pc;       /* 0 = empty slot */
    aot_func_t fn;
} aot_slot_t;

struct aot_state {
    void        *dl;
    aot_slot_t   slots[AOT_HASH_SIZE];
    aot_stats_t  stats;
    /* Fast entry-point bitmap (same format as rom_stubs_hook_bitmap).
     * Checked inline in xtensa_step_impl before aot_lookup. */
    uint64_t     bitmap[HOOK_BITMAP_WORDS];
};

static inline uint32_t aot_hash(uint32_t pc) {
    return (pc * 2654435761u) >> (32 - AOT_HASH_BITS);
}

static void aot_insert(aot_state_t *a, uint32_t pc, aot_func_t fn) {
    uint32_t i = aot_hash(pc);
    while (a->slots[i].pc != 0) {
        if (a->slots[i].pc == pc) return;
        i = (i + 1) & AOT_HASH_MASK;
    }
    a->slots[i].pc = pc;
    a->slots[i].fn = fn;
    a->stats.functions_loaded++;
    uint32_t idx = (pc >> 2) & (HOOK_BITMAP_BITS - 1);
    a->bitmap[idx / 64] |= (uint64_t)1 << (idx & 63);
}

const uint64_t *aot_get_bitmap(const aot_state_t *a) {
    return a ? a->bitmap : NULL;
}

aot_func_t aot_lookup(const aot_state_t *a, uint32_t pc) {
    if (!a) return NULL;
    uint32_t i = aot_hash(pc);
    while (a->slots[i].pc != 0) {
        if (a->slots[i].pc == pc) return a->slots[i].fn;
        i = (i + 1) & AOT_HASH_MASK;
    }
    return NULL;
}

const aot_stats_t *aot_get_stats(const aot_state_t *a) {
    return a ? &a->stats : NULL;
}

/* Walk the dylib's symbol table and register every aot_func_<hex>.
 *
 * Portability: dlopen+dlsym don't expose a "list all symbols" API, so we
 * read the Mach-O / ELF symbol table directly. macOS Mach-O uses
 * mach-o/nlist.h; Linux ELF uses dl_iterate_phdr. For the PoC we walk
 * /tmp/firmware.aot.json (the manifest the recompiler emits) instead —
 * it's the same source of truth and avoids the platform-specific code.
 *
 * Manifest schema:
 *   { "functions": [
 *       { "pc": "0x400d1234", "translated": true, "symbol": "aot_func_400d1234" },
 *       ...
 *     ]
 *   }
 */
static int aot_load_from_manifest(aot_state_t *a, const char *manifest_path) {
    FILE *f = fopen(manifest_path, "r");
    if (!f) {
        fprintf(stderr, "[AOT] manifest %s: %s\n", manifest_path, strerror(errno));
        return -1;
    }
    fseek(f, 0, SEEK_END);
    long sz = ftell(f);
    fseek(f, 0, SEEK_SET);
    char *buf = malloc((size_t)sz + 1);
    if (!buf) { fclose(f); return -1; }
    if (fread(buf, 1, (size_t)sz, f) != (size_t)sz) {
        free(buf); fclose(f); return -1;
    }
    buf[sz] = '\0';
    fclose(f);

    /* Tiny hand-rolled JSON scanner — we only need the (pc, symbol) pairs
     * and the manifest is generated by us so the format is fixed. */
    int loaded = 0;
    char *p = buf;
    while ((p = strstr(p, "\"pc\""))) {
        char *colon = strchr(p, ':');
        if (!colon) break;
        char *q = colon + 1;
        while (*q == ' ' || *q == '"') q++;
        uint32_t pc = (uint32_t)strtoul(q, NULL, 0);

        char *sym_key = strstr(p, "\"symbol\"");
        char *trans_key = strstr(p, "\"translated\"");
        if (!sym_key || !trans_key) { p = colon + 1; continue; }
        /* Verify translated:true */
        char *t_colon = strchr(trans_key, ':');
        if (!t_colon || strncmp(t_colon + 1, " true", 5) != 0) {
            p = colon + 1; continue;
        }

        char *sym_colon = strchr(sym_key, ':');
        char *sym_quote = strchr(sym_colon, '"');
        if (!sym_quote) { p = colon + 1; continue; }
        sym_quote++;
        char *sym_end = strchr(sym_quote, '"');
        if (!sym_end) break;
        *sym_end = '\0';

        aot_func_t fn = (aot_func_t)dlsym(a->dl, sym_quote);
        if (fn) { aot_insert(a, pc, fn); loaded++; }
        *sym_end = '"';
        p = sym_end + 1;
    }
    free(buf);
    return loaded;
}

aot_state_t *aot_load(const char *dylib_path) {
    aot_state_t *a = calloc(1, sizeof(*a));
    if (!a) return NULL;

    a->dl = dlopen(dylib_path, RTLD_NOW | RTLD_LOCAL);
    if (!a->dl) {
        fprintf(stderr, "[AOT] dlopen(%s): %s\n", dylib_path, dlerror());
        free(a);
        return NULL;
    }

    /* Manifest sits next to the dylib. */
    char manifest[1024];
    snprintf(manifest, sizeof(manifest), "%s", dylib_path);
    char *dot = strrchr(manifest, '.');
    if (dot) *dot = '\0';
    strncat(manifest, ".json", sizeof(manifest) - strlen(manifest) - 1);

    int n = aot_load_from_manifest(a, manifest);
    if (n <= 0) {
        fprintf(stderr, "[AOT] no functions loaded from %s\n", manifest);
        dlclose(a->dl);
        free(a);
        return NULL;
    }
    fprintf(stderr, "[AOT] loaded %d functions from %s\n", n, dylib_path);
    return a;
}

void aot_destroy(aot_state_t *a) {
    if (!a) return;
    if (a->dl) dlclose(a->dl);
    free(a);
}
